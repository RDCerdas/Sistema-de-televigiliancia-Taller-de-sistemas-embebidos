## build/conf/bblayers.conf
```bitbake
# POKY_BBLAYERS_CONF_VERSION is increased each time build/conf/bblayers.conf
# changes incompatibly
POKY_BBLAYERS_CONF_VERSION = "2"

BBPATH = "${TOPDIR}"
BBFILES ?= ""
# POKY_BBLAYERS_CONF_VERSION is increased each time build/conf/bblayers.conf
# changes incompatibly
POKY_BBLAYERS_CONF_VERSION = "2"

BBPATH = "${TOPDIR}"
BBFILES ?= ""

BBLAYERS ?= " \
  /home/robert/Embebidos/poky/meta \
  /home/robert/Embebidos/poky/meta-poky \
  /home/robert/Embebidos/poky/meta-raspberrypi \
  /home/robert/Embebidos/poky/meta-openembedded/meta-oe \
  /home/robert/Embebidos/poky/meta-openembedded/meta-perl \
  /home/robert/Embebidos/poky/meta-openembedded/meta-python \
  /home/robert/Embebidos/poky/meta-openembedded/meta-networking \
  /home/robert/Embebidos/poky/meta-openembedded/meta-filesystems \
  /home/robert/Embebidos/poky/meta-openembedded/meta-webserver \
  /home/robert/Embebidos/poky/meta-openembedded/meta-multimedia \
  /home/robert/Embebidos/poky/meta-tv \
  "
```

## meta-tv/conf/layer.conf
```bitbake
# We have a conf and classes directory, add to BBPATH
BBPATH .= ":${LAYERDIR}"

# We have recipes-* directories, add to BBFILES
BBFILES += "${LAYERDIR}/recipes-*/*/*.bb \
	${LAYERDIR}/recipes-*/*/*.bbappend"

BBFILE_COLLECTIONS += "tv"
BBFILE_PATTERN_tv = "^${LAYERDIR}/"
BBFILE_PRIORITY_tv = "6"
```
